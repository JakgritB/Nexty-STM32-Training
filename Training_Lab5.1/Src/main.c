#include <stdint.h>
#define STM32F411xE
#include "stm32f4xx.h"

void USART2_IRQHandler(void) {
	if ((USART2->SR & USART_SR_RXNE) != 0) {
		if (USART2->DR == '1') {
			GPIOA->ODR |= (GPIO_ODR_OD5);

		} else {
			GPIOA->ODR &= ~(GPIO_ODR_OD5);
		}
	}
}

int main(void) {
	RCC->AHB1ENR |= RCC_AHB1ENR_GPIOAEN;
	RCC->APB1ENR |= RCC_APB1ENR_USART2EN;

	// PA5 (LED)
	GPIOA->MODER |= (0b01 << GPIO_MODER_MODER5_Pos);

	// PA2, PA3
	GPIOA->MODER &= ~(GPIO_MODER_MODER2 | GPIO_MODER_MODER3);
	GPIOA->MODER |= (0b10 << GPIO_MODER_MODER2_Pos) + (0b10 << GPIO_MODER_MODER3_Pos);
	GPIOA->AFR[0] &= ~(GPIO_AFRL_AFRL2 | GPIO_AFRL_AFRL3);
	GPIOA->AFR[0] |= (0b0111 << GPIO_AFRL_AFSEL2_Pos) + (0b0111 << GPIO_AFRL_AFSEL3_Pos);

	// USART (RX only)
	USART2->CR1 |= USART_CR1_UE;
	USART2->CR1 &= ~USART_CR1_M;
	USART2->CR2 &= ~USART_CR2_STOP;
	USART2->BRR = 139;
	USART2->CR1 |= USART_CR1_RXNEIE;
	USART2->CR1 |= USART_CR1_RE;

	//interrupt
	NVIC_EnableIRQ(USART2_IRQn);
	NVIC_SetPriority(USART2_IRQn, 0);
	while (1) {

	}
}
